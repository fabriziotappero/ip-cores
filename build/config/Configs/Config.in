## grlib-gpl-1.0.19-b3188/designs/leon3-asic/config.in
```kconfig
#
# LEON3 configuration written in linux configuration language
#
# Written by Jiri Gaisler, Gaisler Research
#
# Comments and bug reports to jiri@gaisler.com
#
#

#define_bool CONFIG_MCTRL_RMW y
#define_bool CONFIG_LEON3FT_PRESENT y

mainmenu_name "LEON3MP Design Configuration"

mainmenu_option next_comment
  comment 'Synthesis      '
  source lib/techmap/gencomp/tech.in
endmenu

mainmenu_option next_comment
  comment 'Clock generation'
  source lib/techmap/clocks/clkgen.in
endmenu

source lib/gaisler/leon3/leon3.in
source lib/grlib/amba/amba.in

mainmenu_option next_comment
  comment 'Debug Link           '
  source lib/gaisler/uart/dcom.in
  source lib/gaisler/jtag/jtag.in
endmenu

mainmenu_option next_comment
  comment 'Memory controllers             '
    source lib/esa/memoryctrl/mctrl.in
    source lib/gaisler/misc/ahbstat.in
endmenu

mainmenu_option next_comment
comment 'Peripherals             '

  mainmenu_option next_comment
  comment 'Spacewire '
    source lib/gaisler/spacewire/spacewire.in
  endmenu

  mainmenu_option next_comment
  comment 'UARTs, timers and irq control         '
    source lib/gaisler/uart/uart1.in
    source lib/gaisler/uart/uart2.in
    source lib/gaisler/leon3/irqmp.in
    source lib/gaisler/misc/gptimer.in
    source lib/gaisler/misc/grgpio.in
  endmenu

endmenu

mainmenu_option next_comment
comment 'VHDL Debugging        '
  source lib/grlib/util/debug.in
endmenu
```

## grlib-gpl-1.0.19-b3188/designs/leon3-digilent-xup/config.in
```kconfig
# LEON3 configuration written in linux configuration language
#
# Written by Jiri Gaisler, Gaisler Research
#
# Comments and bug reports to jiri@gaisler.com
#
#

#define_bool CONFIG_MCTRL_RMW y

mainmenu_name "LEON3MP Design Configuration"

mainmenu_option next_comment
  comment 'Synthesis      '
  source lib/techmap/gencomp/tech.in
endmenu

mainmenu_option next_comment
  comment 'Clock generation'
  source lib/techmap/clocks/clkgen.in
endmenu

source lib/gaisler/leon3/leon3.in
source lib/grlib/amba/amba.in

mainmenu_option next_comment
  comment 'Debug Link           '
  source lib/gaisler/uart/dcom.in
  source lib/gaisler/jtag/jtag.in
  source lib/gaisler/net/edcl.in

endmenu

mainmenu_option next_comment
comment 'Peripherals             '

  source lib/gaisler/ddr/ddrsp.in

  mainmenu_option next_comment
  comment 'On-chip RAM/ROM                 '
    source lib/gaisler/misc/ahbrom.in
    source lib/gaisler/misc/ahbram.in
  endmenu

  mainmenu_option next_comment
  comment 'Ethernet             '
    source lib/gaisler/greth/greth.in
  endmenu

  mainmenu_option next_comment
  comment 'UART, timer, I/O port and interrupt controller'
    source lib/gaisler/uart/uart1.in
    source lib/gaisler/leon3/irqmp.in
    source lib/gaisler/misc/gptimer.in
#    source lib/gaisler/misc/grgpio.in
  endmenu

  mainmenu_option next_comment
  comment 'Keybord and VGA interface'
    source lib/gaisler/misc/ps2vga.in
  endmenu

endmenu

mainmenu_option next_comment
comment 'VHDL Debugging        '
  source lib/grlib/util/debug.in
endmenu
```

## grlib-gpl-1.0.19-b3188/designs/leon3-ge-hpe-midi-ep2s180/config.in
```kconfig
#
# LEON3 configuration written in linux configuration language
#
# Written by Jiri Gaisler, Gaisler Research
#
# Comments and bug reports to jiri@gaisler.com
#
#

define_bool CONFIG_MCTRL_RMW y

mainmenu_name "LEON3MIDI Design Configuration"

mainmenu_option next_comment
  comment 'Synthesis      '
  source lib/techmap/gencomp/tech.in
endmenu

mainmenu_option next_comment
  comment 'Clock generation'
  source lib/techmap/clocks/clkgen.in
endmenu

source lib/gaisler/leon3/leon3.in
source lib/grlib/amba/amba.in

mainmenu_option next_comment
  comment 'Debug Link           '
  source lib/gaisler/uart/dcom.in
  source lib/gaisler/jtag/jtag.in
  source lib/gaisler/net/edcl.in
  source lib/gaisler/usb/grusb_dcl.in
endmenu

mainmenu_option next_comment
comment 'Peripherals             '

  mainmenu_option next_comment
  comment 'Memory controllers             '
    source lib/gaisler/memctrl/srctrl.in
    source lib/esa/memoryctrl/mctrl.in
    source lib/gaisler/memctrl/sdctrl.in
  endmenu

  mainmenu_option next_comment
  comment 'On-chip RAM/ROM                 '
    source lib/gaisler/misc/ahbrom.in
    source lib/gaisler/misc/ahbram.in
  endmenu

  mainmenu_option next_comment
  comment 'Ethernet             '
    source lib/gaisler/greth/greth.in
  endmenu

  mainmenu_option next_comment
  comment 'CAN                     '
    source lib/gaisler/can/can_oc.in
  endmenu

  mainmenu_option next_comment
  comment 'SPI                     '
    source lib/gaisler/misc/spictrl.in
  endmenu

  mainmenu_option next_comment
  comment 'UARTs, timers and irq control         '
    source lib/gaisler/uart/uart1.in
#    source lib/gaisler/uart/uart2.in
    source lib/gaisler/leon3/irqmp.in
    source lib/gaisler/misc/gptimer.in
  endmenu

  mainmenu_option next_comment
  comment 'Keybord and VGA interface'
    source lib/gaisler/misc/ps2vga.in
  endmenu

endmenu

mainmenu_option next_comment
comment 'Gleichmann Options        '
  source lib/gleichmann/ahb2hpi/ahb2hpi.in
  source lib/gleichmann/dac/adcdac.in
  source lib/gleichmann/spi/spi_oc.in
  source lib/gleichmann/multiio/multiio.in
  source lib/gleichmann/ac97/ac97_oc.in
endmenu
mainmenu_option next_comment
comment 'VHDL Debugging        '
  source lib/grlib/util/debug.in
endmenu
```

## grlib-gpl-1.0.19-b3188/designs/leon3-wildcard-xcv300e/config.in
```kconfig
#
# LEON3 configuration written in linux configuration language
#
# Gaisler Research
#
# Comments and bug reports to support@gaisler.com
#
#

mainmenu_name "LEON3 WildCard Design Configuration"

source lib/gaisler/leon3/leon3.in

  mainmenu_option next_comment
  comment 'On-chip RAM'
    source lib/gaisler/misc/ahbram.in
  endmenu
```

## grlib-gpl-1.0.19-b3188/designs/netcard/config.in
```kconfig
#
# Netcard configuration written in linux configuration language
#
# Written by Jiri Gaisler, Gaisler Research
#
# Comments and bug reports to jiri@gaisler.com
#
#

mainmenu_name "Netcard PCI/Ethernet bridge"

mainmenu_option next_comment
  comment 'Synthesis      '
  source lib/techmap/gencomp/tech.in
endmenu

mainmenu_option next_comment
  comment 'Clock generation'
  source lib/techmap/clocks/clkgen.in
endmenu

source lib/grlib/amba/amba.in

mainmenu_option next_comment
  comment 'Debug Link           '
  source lib/gaisler/uart/dcom.in
  source lib/gaisler/jtag/jtag.in
endmenu

  mainmenu_option next_comment
  comment 'On-chip RAM                 '
    source lib/gaisler/misc/ahbram.in
  endmenu

  mainmenu_option next_comment
  comment 'Ethernet             '
    source lib/gaisler/greth/greth.in
  endmenu

  mainmenu_option next_comment
  comment 'PCI              '
    source lib/gaisler/pci/pci_target.in
    source lib/gaisler/pci/pci_mtf.in
    source lib/gaisler/pci/pcidma.in
    source lib/gaisler/pci/pci.in
    source lib/gaisler/pci/pcitrace.in
  endmenu
```

## syn/config.in
```kconfig
mainmenu_option next_comment
  comment 'Synthesis '
  choice 'Target technology                           ' \
	"Generic		CONFIG_SYN_GENERIC \
	Atmel-ATC35		CONFIG_SYN_ATC35 \
	Atmel-ATC25		CONFIG_SYN_ATC25 \
	Atmel-ATC18		CONFIG_SYN_ATC18 \
	UMC-FS90 		CONFIG_SYN_FS90 \
	UMC-0.18 		CONFIG_SYN_UMC018 \
	TSMC-0.25		CONFIG_SYN_TSMC025 \
	Actel-Proasic		CONFIG_SYN_PROASIC \
	Actel-Axcel  		CONFIG_SYN_AXCEL \
	Xilinx-Virtex		CONFIG_SYN_VIRTEX \
	Xilinx-Virtex2		CONFIG_SYN_VIRTEX2" Generic
  if [ "$CONFIG_SYN_GENERIC" != "y" ]; then
    bool 'Infer cache and trace buffer RAM' CONFIG_SYN_INFER_RAM
    bool 'Infer register file' CONFIG_SYN_INFER_REGF
    if [ "$CONFIG_SYN_VIRTEX" = "y" -o "$CONFIG_SYN_VIRTEX2" = "y"]; then
      bool 'Infer ROM' CONFIG_SYN_INFER_ROM
    fi
    if [ "$CONFIG_SYN_VIRTEX" != "y" -a "$CONFIG_SYN_AXCEL" != "y" \
         -a "$CONFIG_SYN_VIRTEX2" != "y" -a "$CONFIG_SYN_PROASIC" != "y" ]; then
      bool 'Infer pads' CONFIG_SYN_INFER_PADS
    fi
    if [ "$CONFIG_SYN_AXCEL" != "y" -a "$CONFIG_SYN_PROASIC" != "y" ]; then
      bool 'Infer PCI pads' CONFIG_SYN_INFER_PCI_PADS
    fi
  fi
  bool 'Infer multiplier' CONFIG_SYN_INFER_MULT
  if [ "$CONFIG_SYN_GENERIC" = "y" -o "$CONFIG_SYN_VIRTEX" = "y" \
     -o "$CONFIG_SYN_AXCEL" = "y" -o "$CONFIG_SYN_ATC25" = "y" \
     -o "$CONFIG_SYN_INFER_REGF" = "y" -o "$CONFIG_SYN_VIRTEX2" = "y"]; then
    bool 'Improve register file write timing' CONFIG_SYN_RFTYPE
  fi
  if [ "$CONFIG_SYN_ATC25" = "y" -o "$CONFIG_SYN_VIRTEX" = "y" -o "$CONFIG_SYN_VIRTEX2" = "y"\
       -o "$CONFIG_SYN_ATC18" = "y" -o "$CONFIG_SYN_TSMC025" = "y" ]; then
    if [ "$CONFIG_SYN_INFER_RAM" != "y" ]; then
      bool 'Use dual-port RAM for DSU trace buffer   ' \
	CONFIG_SYN_TRACE_DPRAM $CONFIG_SYN_ATC25 $CONFIG_SYN_ATC18 \
	$CONFIG_SYN_VIRTEX $CONFIG_SYN_TSMC025 $CONFIG_SYN_VIRTEX2
    fi
  fi

  if [ "$CONFIG_SYN_VIRTEX" = "y" -o "$CONFIG_SYN_VIRTEX2" = "y" ]; then
   
  comment '------------------ Xilinx Clock generation ------------------'
  mainmenu_option next_comment
    
    comment 'Clock generation'
    if [ "$CONFIG_SYN_VIRTEX" = "y" -o "$CONFIG_SYN_VIRTEX2" = "y" ]; then
      bool 'Use Virtex CLKDLL for clock generation' CONFIG_CLK_VIRTEX
    fi
    if [ "$CONFIG_SYN_VIRTEX2" = "y" -a "$CONFIG_CLK_VIRTEX" != "y"]; then
      bool 'Use Virtex-II DCM for clock generation' CONFIG_CLK_VIRTEX2
    fi
    if [ "$CONFIG_CLK_VIRTEX" = "y"]; then
      choice ' System clock multiplier (CLKDLL)' \
	"1/2		CONFIG_CLKDLL_1_2 \
	1		CONFIG_CLKDLL_1_1 \
	2		CONFIG_CLKDLL_2_1" 1
    fi
    if [ "$CONFIG_CLK_VIRTEX2" = "y"]; then
      choice ' System clock multiplier (DCM)' \
	"2/3		CONFIG_DCM_2_3 \
	3/4		CONFIG_DCM_3_4 \
	4/5		CONFIG_DCM_4_5 \
	1		CONFIG_DCM_1_1 \
	5/4		CONFIG_DCM_5_4 \
	4/3		CONFIG_DCM_4_3 \
	3/2		CONFIG_DCM_3_2 \
	5/3		CONFIG_DCM_5_3 \
	2		CONFIG_DCM_2_1 \
	3		CONFIG_DCM_3_1 \
	4		CONFIG_DCM_4_1" 1
    fi
    if [ "$CONFIG_SYN_VIRTEX2" = "y" -o "$CONFIG_CLK_VIRTEX" = "y"]; then
      bool 'Enable CLKDLL for PCI clock' CONFIG_PCI_DLL
    fi
    if [ "$CONFIG_PCI_DLL" != "y" ]; then
      bool 'Use PCI clock as system clock' CONFIG_PCI_SYSCLK
    fi
  endmenu
  fi    

endmenu
```

## syn/spwamba_gr-xc3s1500/config.in
```kconfig
# LEON3 configuration written in linux configuration language
#
# Written by Jiri Gaisler, Gaisler Research
#
# Comments and bug reports to jiri@gaisler.com
#
#

#define_bool CONFIG_MCTRL_RMW y

mainmenu_name "LEON3MP Design Configuration"

mainmenu_option next_comment
  comment 'Synthesis      '
  source lib/techmap/gencomp/tech.in
  choice 'FPGA type                                      ' \
	"XC3S-1500		CONFIG_FPGA_1500 \
	 XC3S-2000		CONFIG_FPGA_2000" XC3S-1500

endmenu

mainmenu_option next_comment
  comment 'Clock generation'
  source lib/techmap/clocks/clkgen.in
endmenu

source lib/gaisler/leon3/leon3.in
source lib/grlib/amba/amba.in

mainmenu_option next_comment
  comment 'Debug Link           '
  source lib/gaisler/uart/dcom.in
  source lib/gaisler/jtag/jtag.in
  source lib/gaisler/usb/grusb_dcl.in
  source lib/gaisler/net/edcl.in
endmenu

mainmenu_option next_comment
comment 'Peripherals             '

  mainmenu_option next_comment
  comment 'Memory controller             '
    source lib/esa/memoryctrl/mctrl.in
    source lib/gaisler/misc/ahbstat.in
  endmenu

  mainmenu_option next_comment
  comment 'On-chip RAM/ROM                 '
#    source lib/gaisler/misc/ahbrom.in
    source lib/gaisler/misc/ahbram.in
  endmenu

  mainmenu_option next_comment
  comment 'Ethernet             '
    source lib/gaisler/greth/greth.in
  endmenu

#  mainmenu_option next_comment
#  comment 'IDE Disk controller  '
#    source lib/gaisler/ata/ata.in
#  endmenu

  mainmenu_option next_comment
  comment 'CAN                     '
    source lib/gaisler/can/can_mc.in
  endmenu

  mainmenu_option next_comment
  comment 'USB 2.0 Device Controller      '
    source lib/gaisler/usb/grusbdc.in
  endmenu

  mainmenu_option next_comment
  comment 'UART, timer, I/O port and interrupt controller'
    source lib/gaisler/uart/uart1.in
    if [ "$CONFIG_DSU_UART" != "y" ]; then
      source lib/gaisler/uart/uart2.in
    fi
    source lib/gaisler/leon3/irqmp.in
    source lib/gaisler/misc/gptimer.in
    source lib/gaisler/misc/grgpio.in
  endmenu

# NOTE: Gaisler SpaceWire core removed to make room for SpaceWire Light
#  mainmenu_option next_comment
#  comment 'Spacewire '
#    source lib/gaisler/spacewire/spacewire.in
#  endmenu

  mainmenu_option next_comment
  comment 'Keybord and VGA interface'
    source lib/gaisler/misc/ps2vga.in
  endmenu
endmenu

mainmenu_option next_comment
comment 'VHDL Debugging        '
  source lib/grlib/util/debug.in
endmenu
```

## vhdl/arm/config.in
```kconfig
mainmenu_option next_comment
  comment 'Target ARM            '
  mainmenu_option next_comment
  comment 'Integer unit                                           '
  endmenu

  source vhdl/mem/cache/config.in

endmenu
    
```

## vhdl/mem/cache/config.in
```kconfig
  mainmenu_option next_comment
  comment 'Cache system              '
  comment 'Instruction cache                              '
  choice 'Associativity (sets)            ' \
	"1		CONFIG_ICACHE_ASSO1 \
	2		CONFIG_ICACHE_ASSO2 \
	3		CONFIG_ICACHE_ASSO3 \
	4		CONFIG_ICACHE_ASSO4" 1
  choice 'Set size (kbytes/set)' \
	"1		CONFIG_ICACHE_SZ1 \
	2		CONFIG_ICACHE_SZ2 \
	4		CONFIG_ICACHE_SZ4 \
	8		CONFIG_ICACHE_SZ8 \
	16		CONFIG_ICACHE_SZ16 \
	32		CONFIG_ICACHE_SZ32 \
	64		CONFIG_ICACHE_SZ64" 2
  choice 'Line size (words/line)' \
	"4		CONFIG_ICACHE_LZ4 \
	8		CONFIG_ICACHE_LZ8" 4
  if [ "$CONFIG_ICACHE_ASSO1" != "y" ]; then
    choice 'Replacement alorithm' \
	"Random		CONFIG_ICACHE_ALGORND " Random
  fi
  bool 'Cache locking      ' CONFIG_GENICACHE_LOCK
  
  comment 'Data cache'

  choice 'Cache type' \
	"Write-back	CONFIG_DCACHE_WRITEBACK \
	 Write-through	CONFIG_DCACHE_WRITETHROUGH " Write-through
  if [ "$CONFIG_DCACHE_WRITETHROUGH" != "y" ]; then
    bool 'Allocate on store' CONFIG_DCACHE_ALLOCATEONSTORE
  fi
  
  choice 'Associativity (sets)' \
	"1		CONFIG_DCACHE_ASSO1 \
	2		CONFIG_DCACHE_ASSO2 \
	3		CONFIG_DCACHE_ASSO3 \
	4		CONFIG_DCACHE_ASSO4" 1
  choice 'Set size (kbytes/set)' \
	"1		CONFIG_DCACHE_SZ1 \
	2		CONFIG_DCACHE_SZ2 \
	4		CONFIG_DCACHE_SZ4 \
	8		CONFIG_DCACHE_SZ8 \
	16		CONFIG_DCACHE_SZ16 \
	32		CONFIG_DCACHE_SZ32 \
	64		CONFIG_DCACHE_SZ64" 2
  choice 'Line size (words/line)' \
	"4		CONFIG_DCACHE_LZ4 \
	 8		CONFIG_DCACHE_LZ8" 4
  if [ "$CONFIG_DCACHE_ASSO1" != "y" ]; then
    choice 'Replacement alorithm' \
	"Random		CONFIG_DCACHE_ALGORND" Random
  fi
  bool 'Cache locking      ' CONFIG_GENDCACHE_LOCK
  choice 'Wribebuffer elements' \
	"1		CONFIG_DCACHE_WB_SZ1 \
	 2		CONFIG_DCACHE_WB_SZ2 \
	 4		CONFIG_DCACHE_WB_SZ4 \
	 8		CONFIG_DCACHE_WB_SZ8 \
	 16		CONFIG_DCACHE_WB_SZ16 " 2

  endmenu


    
```

## vhdl/peripherals/mem/config.in
```kconfig
mainmenu_option next_comment
  comment 'Memory            '

  comment ' Memory controller '
  bool '8-bit PROM/SRAM bus support    ' CONFIG_MCTRL_8BIT
  bool '16-bit PROM/SRAM bus support    ' CONFIG_MCTRL_16BIT
  bool 'RAM write protection            ' CONFIG_PERI_WPROT
  bool 'Write strobe timing feedback            ' CONFIG_MCTRL_WFB
  bool '5th SRAM chip-select  ' CONFIG_MCTRL_5CS
  bool 'SDRAM controller       ' CONFIG_MCTRL_SDRAM
  if [ "$CONFIG_MCTRL_SDRAM" = "y" ]; then
    bool 'Inverted SDRAM clock' CONFIG_MCTRL_SDRAM_INVCLK
  fi
  
  comment ' On chip ram '
  bool 'On-chip AHB RAM                   ' CONFIG_AHBRAM_ENABLE
  if [ "$CONFIG_AHBRAM_ENABLE" = "y" ]; then
      choice 'AHB RAM size (Kbyte)' \
	"1		CONFIG_AHBRAM_SZ1 \
	2		CONFIG_AHBRAM_SZ2 \
	4		CONFIG_AHBRAM_SZ4 \
	8		CONFIG_AHBRAM_SZ8 \
	16		CONFIG_AHBRAM_SZ16 \
	32		CONFIG_AHBRAM_SZ32 \
	64		CONFIG_AHBRAM_SZ64" 4
  fi
  
endmenu
    
```
