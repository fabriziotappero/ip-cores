## vhdl/sparc/config.in
```kconfig
mainmenu_option next_comment
  comment 'Target Sparc            '
  mainmenu_option next_comment
  comment 'Integer unit                                           '
  int 'SPARC register windows' CONFIG_IU_NWINDOWS 8
  bool 'SPARC V8 MUL/DIV instructions' CONFIG_IU_V8MULDIV
  if [ "$CONFIG_IU_V8MULDIV" = "y" ]; then
    choice 'Hardware multiplier latency' \
	"1-cycle		CONFIG_IU_MUL_LATENCY_1 \
	2-cycles		CONFIG_IU_MUL_LATENCY_2 \
	4-cycles		CONFIG_IU_MUL_LATENCY_4 \
	5-cycles		CONFIG_IU_MUL_LATENCY_5 \
	35-cycles		CONFIG_IU_MUL_LATENCY_35" 5-cycles
  fi
  dep_bool 'SPARC V8e SMAC/UMAC instructions     ' CONFIG_IU_MUL_MAC $CONFIG_IU_MUL_LATENCY_4 $CONFIG_IU_V8MULDIV
  int 'Load delay' CONFIG_IU_LDELAY 1
  bool 'Fast jump-address generation   ' CONFIG_IU_FASTJUMP
  bool 'ICC interlock                  ' CONFIG_IU_ICCHOLD
  bool 'Fast instruction decoding      ' CONFIG_IU_FASTDECODE
  if [ "$CONFIG_SYN_TSMC025" = "y" -o "$CONFIG_SYN_UMC018" = "y" \
    -o "$CONFIG_SYN_FS90" = "y" -o "$CONFIG_SYN_PROASIC" = "y" \
    -o "$CONFIG_SYN_ATC18" = "y" \
    -o "$CONFIG_SYN_AXCEL" = "y" -o "$CONFIG_SYN_ATC25" = "y" ]; then
    bool 'Register file power-saving     ' CONFIG_IU_RFPOW
  fi
  int 'Hardware watchpoints' CONFIG_IU_WATCHPOINTS 0
  hex 'PSR imlementation ID' CONFIG_IU_IMPL 0
  hex 'PSR version ID' CONFIG_IU_VER 0
  endmenu
  mainmenu_option next_comment
  comment 'Floating-point unit'
  bool 'Enable FPU                             ' CONFIG_FPU_ENABLE
  if [ "$CONFIG_FPU_ENABLE" = "y" ]; then
    choice 'FPU core' \
	"GRFPU		CONFIG_FPU_GRFPU \
	Meiko		CONFIG_FPU_MEIKO \
	LTH		CONFIG_FPU_LTH" CONFIG_FPU_GRFPU
    int 'FSR version ID' CONFIG_FPU_VER 0
  fi
  endmenu
  mainmenu_option next_comment
  comment 'Co-processor'
  bool 'Enable co-processor       ' CONFIG_CP_ENABLE
  if [ "$CONFIG_CP_ENABLE" = "y" ]; then
    string 'Co-processor configuration' CONFIG_CP_CFG "cp_none"
  fi
  endmenu
  mainmenu_option next_comment
  comment 'Cache system              '
  comment 'Instruction cache                              '
  choice 'Associativity (sets)            ' \
	"1		CONFIG_ICACHE_ASSO1 \
	2		CONFIG_ICACHE_ASSO2 \
	3		CONFIG_ICACHE_ASSO3 \
	4		CONFIG_ICACHE_ASSO4" 1
  choice 'Set size (kbytes/set)' \
	"1		CONFIG_ICACHE_SZ1 \
	2		CONFIG_ICACHE_SZ2 \
	4		CONFIG_ICACHE_SZ4 \
	8		CONFIG_ICACHE_SZ8 \
	16		CONFIG_ICACHE_SZ16 \
	32		CONFIG_ICACHE_SZ32 \
	64		CONFIG_ICACHE_SZ64" 2
  choice 'Line size (bytes/line)' \
	"16		CONFIG_ICACHE_LZ16 \
	32		CONFIG_ICACHE_LZ32" 16
  if [ "$CONFIG_ICACHE_ASSO1" != "y" ]; then
    choice 'Replacement alorithm' \
	"Random		CONFIG_ICACHE_ALGORND \
	LRR		CONFIG_ICACHE_ALGOLRR \
	LRU		CONFIG_ICACHE_ALGOLRU" Random
    bool 'Cache locking      ' CONFIG_ICACHE_LOCK
  fi
  comment 'Data cache'
  choice 'Associativity (sets)' \
	"1		CONFIG_DCACHE_ASSO1 \
	2		CONFIG_DCACHE_ASSO2 \
	3		CONFIG_DCACHE_ASSO3 \
	4		CONFIG_DCACHE_ASSO4" 1
  choice 'Set size (kbytes/set)' \
	"1		CONFIG_DCACHE_SZ1 \
	2		CONFIG_DCACHE_SZ2 \
	4		CONFIG_DCACHE_SZ4 \
	8		CONFIG_DCACHE_SZ8 \
	16		CONFIG_DCACHE_SZ16 \
	32		CONFIG_DCACHE_SZ32 \
	64		CONFIG_DCACHE_SZ64" 2
  choice 'Line size (bytes/line)' \
	"16		CONFIG_DCACHE_LZ16 \
	32		CONFIG_DCACHE_LZ32" 16
  if [ "$CONFIG_DCACHE_ASSO1" != "y" ]; then
    choice 'Replacement alorithm' \
	"Random		CONFIG_DCACHE_ALGORND \
	LRR		CONFIG_DCACHE_ALGOLRR \
	LRU		CONFIG_DCACHE_ALGOLRU" Random
    bool 'Cache locking      ' CONFIG_DCACHE_LOCK
  fi
  if [ "$CONFIG_SYN_ATC25" = "y" -o "$CONFIG_SYN_VIRTEX" = "y" -o "$CONFIG_SYN_VIRTEX2" = "y" \
	-o "$CONFIG_SYN_ATC18" = "y" -o "$CONFIG_SYN_TSMC025" = "y" ]; then
    if [ "$CONFIG_SYN_INFER_RAM" != "y" -a "$CONFIG_MMU_ENABLE" != "y" ]; then
      bool 'AHB snooping       ' CONFIG_DCACHE_SNOOP
    fi
  fi
  if [ "$CONFIG_DCACHE_SNOOP" = "y" ]; then
  choice 'Snoop implementation' \
	"Slow		CONFIG_DCACHE_SNOOP_SLOW \
	Fast		CONFIG_DCACHE_SNOOP_FAST" Slow
  fi
  if [ "$CONFIG_DCACHE_ASSO1" != "y" ]; then
      bool 'Fast read-data generation   ' CONFIG_DCACHE_RFAST
  fi
  if [ "$CONFIG_DCACHE_ASSO1" != "y" ]; then
      bool 'Fast write-data generation   ' CONFIG_DCACHE_WFAST
  fi
  if [ "$CONFIG_MMU_ENABLE" != "y" ]; then
    bool 'Enable local data RAM            ' CONFIG_DCACHE_LRAM
  fi
    if [ "$CONFIG_DCACHE_LRAM" = "y" ]; then
      choice 'Local data RAM size (kbytes)' \
	"1		CONFIG_DCACHE_LRAM_SZ1 \
	2		CONFIG_DCACHE_LRAM_SZ2 \
	4		CONFIG_DCACHE_LRAM_SZ4 \
	8		CONFIG_DCACHE_LRAM_SZ8 \
	16		CONFIG_DCACHE_LRAM_SZ16 \
	32		CONFIG_DCACHE_LRAM_SZ32 \
	64		CONFIG_DCACHE_LRAM_SZ64" 2
      hex ' Local RAM start address (8 MSB) ' CONFIG_DCACHE_LRSTART 0x8f
    fi
  endmenu
  mainmenu_option next_comment
  comment 'MMU'
  bool 'Enable MMU       ' CONFIG_MMU_ENABLE
  if [ "$CONFIG_MMU_ENABLE" = "y" ]; then
    choice 'MMU type              ' \
	"combined	CONFIG_MMU_COMBINED \
	 split		CONFIG_MMU_SPLIT" combined
    choice 'TLB replacement sheme              ' \
	"LRU      	CONFIG_MMU_REPARRAY \
	 Increment	CONFIG_MMU_REPINCREMENT" increment 
       choice 'Instruction (or combined) TLB entries' \
	"2		CONFIG_MMU_I2 \
	4		CONFIG_MMU_I4 \
	8		CONFIG_MMU_I8 \
	16		CONFIG_MMU_I16 \
	32		CONFIG_MMU_I32" 8
    if [ "$CONFIG_MMU_SPLIT" = "y" ]; then
       choice 'Data TLB entries' \
	"2		CONFIG_MMU_D2 \
	4		CONFIG_MMU_D4 \
	8		CONFIG_MMU_D8 \
	16		CONFIG_MMU_D16 \
	32		CONFIG_MMU_D32" 8
    fi         
    bool 'Enable Diagnostic Access       ' CONFIG_MMU_DIAG
  fi
  endmenu
endmenu
    
```
