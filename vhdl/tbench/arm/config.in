## vhdl/tbench/config.in
```kconfig
mainmenu_option next_comment
comment 'VHDL Debugging        '

  bool 'Accelerated UART tracing       ' CONFIG_DEBUG_UART

  if ["$CONFIG_TARGET_ARM" = "y" ]; then
    source vhdl/tbench/arm/config.in
  fi
  if ["$CONFIG_TARGET_SPARC" = "y" ]; then
    source vhdl/tbench/sparc/config.in
  fi

endmenu
```
