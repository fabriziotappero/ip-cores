INCDIR += +$(IPVLOG)/ethmac
SRC += $(IPVLOG)/ethmac/eth_clockgen.v
SRC += $(IPVLOG)/ethmac/eth_cop.v
SRC += $(IPVLOG)/ethmac/eth_crc.v
SRC += $(IPVLOG)/ethmac/eth_fifo.v
SRC += $(IPVLOG)/ethmac/eth_maccontrol.v
SRC += $(IPVLOG)/ethmac/eth_macstatus.v
SRC += $(IPVLOG)/ethmac/eth_miim.v
SRC += $(IPVLOG)/ethmac/eth_outputcontrol.v
SRC += $(IPVLOG)/ethmac/eth_random.v
SRC += $(IPVLOG)/ethmac/eth_receivecontrol.v
SRC += $(IPVLOG)/ethmac/eth_registers.v
SRC += $(IPVLOG)/ethmac/eth_register.v
SRC += $(IPVLOG)/ethmac/eth_rxaddrcheck.v
SRC += $(IPVLOG)/ethmac/eth_rxcounters.v
SRC += $(IPVLOG)/ethmac/eth_rxethmac.v
SRC += $(IPVLOG)/ethmac/eth_rxstatem.v
SRC += $(IPVLOG)/ethmac/eth_shiftreg.v
SRC += $(IPVLOG)/ethmac/eth_spram_256x32.v
SRC += $(IPVLOG)/ethmac/eth_top.v
SRC += $(IPVLOG)/ethmac/eth_transmitcontrol.v
SRC += $(IPVLOG)/ethmac/eth_txcounters.v
SRC += $(IPVLOG)/ethmac/eth_txethmac.v
SRC += $(IPVLOG)/ethmac/eth_txstatem.v
SRC += $(IPVLOG)/ethmac/eth_wishbone.v

DEP += $(IPVLOG)/ethmac/eth_defines.v
DEP += $(IPVLOG)/ethmac/timescale.v
