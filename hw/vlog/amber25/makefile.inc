INCDIR += +$(IPVLOG)/amber25
SRC += $(IPVLOG)/amber25/a25_alu.v
SRC += $(IPVLOG)/amber25/a25_barrel_shift.v
SRC += $(IPVLOG)/amber25/a25_coprocessor.v
SRC += $(IPVLOG)/amber25/a25_core.v
SRC += $(IPVLOG)/amber25/a25_dcache.v
SRC += $(IPVLOG)/amber25/a25_decode.v
SRC += $(IPVLOG)/amber25/a25_decompile.v
SRC += $(IPVLOG)/amber25/a25_execute.v
SRC += $(IPVLOG)/amber25/a25_fetch.v
SRC += $(IPVLOG)/amber25/a25_icache.v
SRC += $(IPVLOG)/amber25/a25_mem.v
SRC += $(IPVLOG)/amber25/a25_multiply.v
SRC += $(IPVLOG)/amber25/a25_register_bank.v
SRC += $(IPVLOG)/amber25/a25_shifter.v
SRC += $(IPVLOG)/amber25/a25_wishbone_buf.v
SRC += $(IPVLOG)/amber25/a25_wishbone.v
SRC += $(IPVLOG)/amber25/a25_write_back.v
DEP += $(IPVLOG)/amber25/a25_config_defines.vh
DEP += $(IPVLOG)/amber25/a25_functions.vh
DEP += $(IPVLOG)/amber25/a25_localparams.vh
