/*
 * Userspace linker script
 *
 * Copyright (C) 2007 - 2009 Bahadir Balban
 */

virtual_base = %s;
physical_base = %s;

__stack = (virtual_base - 0x1000 - 8); /* First page before the env/args */

offset = virtual_base - physical_base;

ENTRY(_start)

SECTIONS
{
	. = virtual_base;
	_start_text = .;
	.text : AT (ADDR(.text) - offset) {
		*(.text.head)
		*(.text)
	}
	.rodata : AT (ADDR(.rodata) - offset) {
		*(.rodata)
	}
	.rodata1 : AT (ADDR(.rodata1) - offset) {
		*(.rodata1)
	}

	. = ALIGN(4K);
	.data : AT (ADDR(.data) - offset) {
		_start_test_exec = .;
		*(.testexec)
		_end_test_exec = .;
		*(.data)
	}
	.got : AT (ADDR(.got) - offset) {
		*(.got)
	}
	.got.plt : AT (ADDR(.got.plt) - offset) {
		*(.got.plt)
	}
	.bss : AT (ADDR(.bss) - offset) {
		*(.bss)
	}
	_end = .;
}
