# nios_ii_sdram: IP-XACT component
VLNV Altera:ip.hwp.cpu:nios_ii_sdram:1.0
Nios2 SDRAM subsystem.

## Bus interfaces (logical=physical port)
clk: slave TUT:ip.hwp.interface:clock.busdef:1.0
  CLK[0:0]=clk_0[0:0]
hibi_master: master TUT:ip.hwp.communication:hibi_ip_r4.busdef:3.0
  AV[0:0]=hibi_av_out_from_the_hibi_pe_dma_1[0:0], COMM[4:0]=hibi_comm_out_from_the_hibi_pe_dma_1[4:0], DATA[31:0]=hibi_data_out_from_the_hibi_pe_dma_1[31:0], RE[0:0]=hibi_re_out_from_the_hibi_pe_dma_1[0:0], WE[0:0]=hibi_we_out_from_the_hibi_pe_dma_1[0:0]
rst_n: slave TUT:ip.hwp.interface:reset.busdef:1.0
  RESETn[0:0]=reset_n[0:0]
sdram_if: master TUT:ip.hwp.storage:sdram_io.busdef:1.0
  sdram_address_out[11:0]=zs_addr_from_the_sdram_1[11:0], sdram_ba_out[1:0]=zs_ba_from_the_sdram_1[1:0], sdram_cas_n_out[0:0]=zs_cas_n_from_the_sdram_1[0:0], sdram_cke_out[0:0]=zs_cke_from_the_sdram_1[0:0], sdram_cs_n_out[0:0]=zs_cs_n_from_the_sdram_1[0:0], sdram_ras_n_out[0:0]=zs_ras_n_from_the_sdram_1[0:0], sdram_data_inout[15:0]=zs_dq_to_and_from_the_sdram_1[15:0], sdram_we_n_out[0:0]=zs_we_n_from_the_sdram_1[0:0], sdram_dqm_out[1:0]=zs_dqm_from_the_sdram_1[1:0]
hibi_slave: slave TUT:ip.hwp.communication:hibi_ip_r4.busdef:3.0, memory map hibi_mem_map
  AV[0:0]=hibi_av_in_to_the_hibi_pe_dma_1[0:0], COMM[4:0]=hibi_comm_in_to_the_hibi_pe_dma_1[4:0], DATA[31:0]=hibi_data_in_to_the_hibi_pe_dma_1[31:0], EMPTY[0:0]=hibi_empty_in_to_the_hibi_pe_dma_1[0:0], FULL[0:0]=hibi_full_in_to_the_hibi_pe_dma_1[0:0]

## Ports
in clk_0[0:0]
in hibi_av_in_to_the_hibi_pe_dma_1
out hibi_av_out_from_the_hibi_pe_dma_1
in hibi_comm_in_to_the_hibi_pe_dma_1[4:0]
out hibi_comm_out_from_the_hibi_pe_dma_1[4:0]
in hibi_data_in_to_the_hibi_pe_dma_1[31:0]
out hibi_data_out_from_the_hibi_pe_dma_1[31:0]
in hibi_empty_in_to_the_hibi_pe_dma_1
in hibi_full_in_to_the_hibi_pe_dma_1
out hibi_re_out_from_the_hibi_pe_dma_1
out hibi_we_out_from_the_hibi_pe_dma_1
in reset_n[0:0]
out zs_addr_from_the_sdram_1[11:0]
out zs_ba_from_the_sdram_1[1:0]
out zs_cas_n_from_the_sdram_1
out zs_cke_from_the_sdram_1
out zs_cs_n_from_the_sdram_1
inout zs_dq_to_and_from_the_sdram_1[15:0]
out zs_dqm_from_the_sdram_1[1:0]
out zs_ras_n_from_the_sdram_1
out zs_we_n_from_the_sdram_1

## Address spaces and blocks
avalon_addr_space: range 4G, width 32
hibi_addr_space: range 4G, width 32
hibi_mem_map.hibi_addr_block: base 0x0, range 32, width 32, reserved

## Registers
Registers are 32-bit, read-write, no defined reset value unless marked. A register's access mark holds for its fields unless they carry their own. Offsets are from the block's base; lines under a group give offsets from that group; [hi:lo] are bit positions; {n}, {i} and the like mark numbered series; 'fields as' and 'values as' point back to an identical list; <NAME> marks a mode.

## avalon_addr_space.HIBI_PE_DMA
Base 0x00000000
0x00 RX_INITIALIZE wo — Initializes the channel
0x01 CONTROL
0x02 IRQ_STATUS — Read IRQ status and acknoledge interrupts
0x03 TX_MEM_ADDR wo — Address where data to be sent begins
0x04 TX_WORDS ro — How many words to send
0x05 TX_COMM wo — Hibi command to send the data with
0x06 TX_HIBI_ADDR wo — Hibi address to send the data
0x07 RX_HIBI_DATA ro — Current data on hibi rx interface
0x08 RX_MEM_ADDR — Address where channel n stores received data
0x09 RX_WORDS — How many words to receive for packet channel n or read
0x0A RX_HIBI_ADDR — Hibi address for channel n to listen
