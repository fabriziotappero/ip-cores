# nios_ii_sram: IP-XACT component
VLNV Altera:ip.hwp.cpu:nios_ii_sram:1.0
Nios2 subsystem using SRAM as a data and program memory. Includes HIBI_PE_DMA for hibi communication.

## Bus interfaces (logical=physical port)
clk: slave TUT:ip.hwp.interface:clock.busdef:1.0
  CLK[0:0]=clk_0[0:0]
hibi_master: master TUT:ip.hwp.communication:hibi_ip_r4.busdef:3.0, address space hibi_addr_space
  AV[0:0]=hibi_av_out_from_the_hibi_pe_dma_0[0:0], COMM[4:0]=hibi_comm_out_from_the_hibi_pe_dma_0[4:0], DATA[31:0]=hibi_data_out_from_the_hibi_pe_dma_0[31:0], RE[0:0]=hibi_re_out_from_the_hibi_pe_dma_0[0:0], WE[0:0]=hibi_we_out_from_the_hibi_pe_dma_0[0:0]
rst_n: slave TUT:ip.hwp.interface:reset.busdef:1.0
  RESETn[0:0]=reset_n[0:0]
sram_if: master TUT:ip.hwp.storage:sram_io.busdef:1.0
  SRAM_UB_N_FROM_SRAM[0:0]=SRAM_UB_N_from_the_sram_0[0:0], SRAM_WE_N_FROM_SRAM[0:0]=SRAM_WE_N_from_the_sram_0[0:0], SRAM_LB_N_FROM_SRAM[0:0]=SRAM_LB_N_from_the_sram_0[0:0], SRAM_CE_N_FROM_SRAM[0:0]=SRAM_CE_N_from_the_sram_0[0:0], SRAM_OE_N_FROM_SRAM[0:0]=SRAM_OE_N_from_the_sram_0[0:0], SRAM_DQ_TO_AND_FROM_SRAM[15:0]=SRAM_DQ_to_and_from_the_sram_0[15:0], SRAM_ADDR_FROM_SRAM[17:0]=SRAM_ADDR_from_the_sram_0[17:0]
hibi_slave: slave TUT:ip.hwp.communication:hibi_ip_r4.busdef:3.0, memory map hibi_mem_map
  AV[0:0]=hibi_av_in_to_the_hibi_pe_dma_0[0:0], COMM[4:0]=hibi_comm_in_to_the_hibi_pe_dma_0[4:0], DATA[31:0]=hibi_data_in_to_the_hibi_pe_dma_0[31:0], EMPTY[0:0]=hibi_empty_in_to_the_hibi_pe_dma_0[0:0], FULL[0:0]=hibi_full_in_to_the_hibi_pe_dma_0[0:0]

## Ports
out SRAM_ADDR_from_the_sram_0[17:0]
out SRAM_CE_N_from_the_sram_0
inout SRAM_DQ_to_and_from_the_sram_0[15:0]
out SRAM_LB_N_from_the_sram_0
out SRAM_OE_N_from_the_sram_0
out SRAM_UB_N_from_the_sram_0
out SRAM_WE_N_from_the_sram_0
in clk_0[0:0]
in hibi_av_in_to_the_hibi_pe_dma_0[0:0]
out hibi_av_out_from_the_hibi_pe_dma_0
in hibi_comm_in_to_the_hibi_pe_dma_0[4:0]
out hibi_comm_out_from_the_hibi_pe_dma_0[4:0]
in hibi_data_in_to_the_hibi_pe_dma_0[31:0]
out hibi_data_out_from_the_hibi_pe_dma_0[31:0]
in hibi_empty_in_to_the_hibi_pe_dma_0
in hibi_full_in_to_the_hibi_pe_dma_0
out hibi_re_out_from_the_hibi_pe_dma_0
out hibi_we_out_from_the_hibi_pe_dma_0
in reset_n

## Address spaces and blocks
avalon_addr_space: range 4G, width 32
hibi_addr_space: range 4G, width 32
hibi_mem_map.hibi_addr_block: base 0x0, range 32, width 32, reserved

## Registers
Registers are 32-bit, read-write, no defined reset value unless marked. A register's access mark holds for its fields unless they carry their own. Offsets are from the block's base; lines under a group give offsets from that group; [hi:lo] are bit positions; {n}, {i} and the like mark numbered series; 'fields as' and 'values as' point back to an identical list; <NAME> marks a mode.

## avalon_addr_space.HIBI_PE_DMA
Base 0x00000500
0x00 RX_INITIALIZE wo — Initializes the channel
0x01 CONTROL
0x02 IRQ_STATUS — Read IRQ status and acknoledge interrupts
0x03 TX_MEM_ADDR wo — Address where data to be sent begins
0x04 TX_WORDS ro — How many words to send
0x05 TX_COMM wo — Hibi command to send the data with
0x06 TX_HIBI_ADDR wo — Hibi address to send the data
0x07 RX_HIBI_DATA ro — Current data on hibi rx interface
0x08 RX_MEM_ADDR — Address where channel n stores received data
0x09 RX_WORDS — How many words to receive for packet channel n or read acknowledge for stream channel n
0x0A RX_HIBI_ADDR — Hibi address for channel n to listen
